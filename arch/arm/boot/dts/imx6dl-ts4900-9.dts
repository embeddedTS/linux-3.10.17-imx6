/*
 * Copyright 2011 Freescale Semiconductor, Inc.
 * Copyright 2011 Linaro Ltd.
 *
 * The code contained herein is licensed under the GNU General Public
 * License. You may obtain a copy of the GNU General Public License
 * Version 2 or later at the following locations:
 *
 * http://www.opensource.org/licenses/gpl-license.html
 * http://www.gnu.org/copyleft/gpl.html
 */

/dts-v1/;
#include "imx6dl.dtsi"
#include "imx6qdl-ts4900-9.dtsi"

/ {
	model = "Technologic Systems i.MX6 Solo/DualLite TS-4900 (TS-8150)";
	compatible = "fsl,imx6dl-ts4900", "fsl,imx6dl";
};
